#define ASM_FILE
#include "mlayout.h"

ENTRY(sys_entry)

SECTIONS
{
	. = KERNEL_IMAGE_VADDR;

	.multiboot_header ALIGN(KERNEL_PAGE_SIZE) : AT(ADDR(.multiboot_header) + KERNEL_IMAGE_PADDR - KERNEL_IMAGE_VADDR)
	{
		*(.multiboot_header)
	}

	.text ALIGN(KERNEL_PAGE_SIZE) : AT(ADDR(.text) + KERNEL_IMAGE_PADDR - KERNEL_IMAGE_VADDR)
	{
		*(.text)
	}

	.data ALIGN(KERNEL_PAGE_SIZE) : AT(ADDR(.data) + KERNEL_IMAGE_PADDR - KERNEL_IMAGE_VADDR)
	{
		*(.data)
		*(.rodata*)
	}

	.bss ALIGN(KERNEL_PAGE_SIZE) : AT(ADDR(.bss) + KERNEL_IMAGE_PADDR - KERNEL_IMAGE_VADDR)
	{
		*(.bss)
		*(COMMON)
	}
}
